## drivers/android/pram_console/Kconfig
```kconfig
menu "Legacy Android Persistent RAM"

config ANDROID_PERSISTENT_RAM
	bool "Android Persistent RAM"
	select REED_SOLOMON
	select REED_SOLOMON_ENC8
	select REED_SOLOMON_DEC8
    help
        Read drivers/android/pram_console/README.md

config ANDROID_RAM_CONSOLE
	bool "Android RAM buffer console"
	default n
	select ANDROID_PERSISTENT_RAM
    help
        Read drivers/android/pram_console/README.md

config ANDROID_RAM_CONSOLE_SAMSUNG_KLTE
	bool "RAM console configuration for Samsung KLTE devices "
	depends on ANDROID_RAM_CONSOLE

endmenu
```

## drivers/staging/android/Kconfig
```kconfig
# SPDX-License-Identifier: GPL-2.0
menu "Android"

config ASHMEM
	bool "Enable the Anonymous Shared Memory Subsystem"
	depends on SHMEM
	help
	  The ashmem subsystem is a new shared memory allocator, similar to
	  POSIX SHM but with different behavior and sporting a simpler
	  file-based API.

	  It is, in theory, a good memory allocator for low-memory devices,
	  because it can discard shared memory units when under memory pressure.

config ANDROID_LOGGER
	tristate "Android log driver"
	default n
	help
	  This adds support for system-wide logging using four log buffers.

	  These are:

	      1: main
	      2: events
	      3: radio
	      4: system

	  Log reading and writing is performed via normal Linux reads and
	  optimized writes. This optimization avoids logging having too
	  much overhead in the system.

config ANDROID_RAM_CONSOLE
	bool "Android RAM buffer console"
	default n
	select ANDROID_PERSISTENT_RAM

config ANDROID_PERSISTENT_RAM
	depends on PSTORE=n
	select REED_SOLOMON
	select REED_SOLOMON_ENC8  
	select REED_SOLOMON_DEC8
	bool

endmenu
```
